## meta-plc/recipes-core/images/wic/plc-hmi-rauc.wks
```
part /boot --source bootimg-partition --ondisk mmcblk0 --fstype=vfat --label boot --active --align 4096 --size 100
part / --source rootfs --ondisk mmcblk0 --fstype=ext4 --label rootfs_A --align 4096 --size 2500
part / --source rootfs --ondisk mmcblk0 --fstype=ext4 --label rootfs_B --align 4096 --size 2500
part /data --ondisk mmcblk0 --fstype=ext4 --label data --align 4096 --size 1024
```
